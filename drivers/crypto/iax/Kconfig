## drivers/crypto/iax/Kconfig
```kconfig
config CRYPTO_DEV_IAX_CRYPTO
	tristate "IAX Crypto Driver"
	depends on CRYPTO_DEFLATE
	depends on INTEL_IDXD
	default n
	help
	  This driver supports Intel analytics accelerator hardware.
	  The module will be called iax_crypto.
```

## drivers/ift/Kconfig
```kconfig
config IFT
	tristate "IFT"
	depends on X86 && 64BIT && SMP
	default	n
	help
	  Enable support for Scan At Field in Intel Xeon CPU to perform core
	  logic test in the field. To compile this driver as a module, choose
	  M here. The module will be called saf.

	  If unsure, say N.
```

## drivers/platform/x86/intel/ifs/Kconfig
```kconfig
config INTEL_IFS
	tristate "Intel In Field Scan"
	depends on X86 && 64BIT && SMP
	help
	  Enable support for In Field Scan in Intel CPU to perform core
	  logic test in the field. To compile this driver as a module, choose
	  M here. The module will be called intel_ifs.

	  If unsure, say N.
```

## drivers/vfio/mdev/Kconfig
```kconfig
# SPDX-License-Identifier: GPL-2.0-only

config VFIO_MDEV
	tristate "Mediated device driver framework"
	default n
	help
	  Provides a framework to virtualize devices.
	  See Documentation/driver-api/vfio-mediated-device.rst for more details.

	  If you don't know what do here, say N.

config VFIO_MDEV_IDXD
	tristate "VFIO Mediated device driver for Intel IDXD"
	depends on VFIO && VFIO_MDEV && X86_64
	select IMS_MSI_ARRAY
	default n
	help
	  VFIO based mediated device driver for
	  Intel Accelerator Devices driver.
```
